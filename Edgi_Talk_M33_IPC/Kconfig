## Edgi_Talk_M33_IPC/Kconfig
```kconfig
mainmenu "RT-Thread Configuration"

config BSP_DIR
    string
    option env="BSP_ROOT"
    default "."

config RTT_DIR
    string
    option env="RTT_ROOT"
    default "rt-thread"

config PKGS_DIR
    string
    option env="PKGS_ROOT"
    default "packages"

config ENV_DIR
    string
    option env="ENV_ROOT"
    default "/"

config PLATFORM_DIR
    string
    option env="PLATFORM_DIR"
    default "C:/RT-ThreadStudio/workspace/Edgi_Talk_M33_IPC/platform"

source "$RTT_DIR/Kconfig"
source "$PKGS_DIR/Kconfig"
source "$RTT_DIR/../libraries/components/CherryUSB-1.6.0/Kconfig.rtt"
source "$RTT_DIR/../libraries/M33_Config/Kconfig"
```
